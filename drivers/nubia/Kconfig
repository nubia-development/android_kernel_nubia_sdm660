## drivers/nubia/Kconfig
```kconfig
#
# Nubia drivers configuration
#

#menuconfig NUBIA_DRIVERS
menu "nubia drivers"

config NUBIA_DRIVERS
	bool "NUBIA DRIVERS"
	default n
	help
	  Say Y here if you want to enable NUBIA DRIVERS
	  If unsure, say N.

comment "Nubia Device Drivers"

if NUBIA_DRIVERS
# Add nubia drivers configuration here

config NUBIA_DISPLAY
	bool "NUBIA_DISPLAY"
	depends on NUBIA_DRIVERS
	default n
	help
	  Say Y here if you want to enable NUBIA_DISPLAY
	  If unsure, say N.

if NUBIA_DISPLAY
source "drivers/nubia/display/Kconfig"
endif

config NUBIA_FINGERPRINT
	bool "NUBIA_FINGERPRINT"
	depends on NUBIA_DRIVERS
	default n
	help
	  Say Y here if you want to enable NUBIA_FINGERPRINT
	  If unsure, say N.

if NUBIA_FINGERPRINT
source "drivers/nubia/fingerprint/Kconfig"
endif

config NUBIA_SENSORS
	bool "NUBIA_SENSORS"
	depends on NUBIA_DRIVERS
	default n
	help
	  Say Y here if you don't want to enable NUBIA_SENSORS
	  If unsure, say N.

if NUBIA_SENSORS
source drivers/nubia/sensors/Kconfig
endif

config NUBIA_TOUCHSCREENS
	bool "NUBIA_TOUCHSCREENS"
	depends on NUBIA_DRIVERS
	default n
	help
	  Say Y here if you want to enable NUBIA_TOUCHSCREENS
	  If unsure, say N.

if NUBIA_TOUCHSCREENS
source "drivers/nubia/touch/Kconfig"
endif

endif

endmenu
```

## drivers/nubia/fingerprint/Kconfig
```kconfig
menu "nubia fingerprint driver"

config NUBIA_SUNWAVE_FP
        bool "config nubia fingerprint sunwave"
        default n
        help
          Say Y here if you have a nubia fingerprint sunwave connected
          to your system.
	  If unsure, say N.

endmenu
```

## drivers/nubia/sensors/Kconfig
```kconfig
config NUBIA_SENSORS_TMD2725
	tristate "support litehole light/prox sensor driver"
	depends on NUBIA_SENSORS
	default n
	help
		nubia ambient&&prox device of tmd2725
```
