&spmi_bus {
	qcom,pm660@1 {
		/delete-node/ qcom,haptics@c000;
		pm660_haptics: qcom,haptic@c000 {
			compatible = "qcom,qpnp-haptic";
			reg = <0xc000 0x100>;
			interrupts = <0x1 0xc0 0x0 IRQ_TYPE_EDGE_BOTH>,
				     <0x1 0xc0 0x1 IRQ_TYPE_EDGE_BOTH>;
			interrupt-names = "sc-irq", "play-irq";
			qcom,pmic-revid = <&pm660_revid>;
			qcom,pmic-misc = <&pm660_misc>;
			qcom,misc-clk-trim-error-reg = <0xf3>;
			qcom,actuator-type = "erm";
			qcom,play-mode = "direct";
			qcom,vmax-mv = <2700>;
			qcom,ilim-ma = <800>;
			qcom,wave-shape = "square";
			//qcom,wave-play-rate-us = <6667>;
                        qcom,wave-play-rate-us = <4286>;
                        //qcom,int-pwm-freq-khz = <505>;
			qcom,int-pwm-freq-khz = <500>;
			qcom,sc-deb-cycles = <32>;
			qcom,en-brake;
			qcom,brake-pattern = [03 03 00 00];
                        qcom,ztemt_vibrator_ms = <60>;
		};
	};
};

