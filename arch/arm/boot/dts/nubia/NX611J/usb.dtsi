&soc {
	usb3: ssusb@a800000 {
		dwc3@a800000 {
			maximum-speed = "high-speed";
		};

        };
};

&qusb_phy0{
		qcom,qusb-phy-init-seq = <0xf8 0x80
					0x90 0x84
					0x83 0x88
					0xc0 0x8c
					0x03 0x90
					0x30 0x08
					0x79 0x0c
					0x21 0x10
					0x14 0x9c
					0x9f 0x1c
					0x00 0x18>;
};
